## conf/layer.conf
```bitbake
# We have a conf and classes directory, add to BBPATH
BBPATH .= ":${LAYERDIR}"

# We have recipes-* directories, add to BBFILES
BBFILES += "${LAYERDIR}/recipes-*/*/*.bb ${LAYERDIR}/recipes-*/*/*.bbappend"

BBFILE_COLLECTIONS += "zarhus-webkit"
BBFILE_PATTERN:zarhus-webkit = "^${LAYERDIR}/"
BBFILE_PRIORITY:zarhus-webkit = "1"

# This should only be incremented on significant changes that will
# cause compatibility issues with other layers
LAYERVERSION:zarhus-webkit = "1"

LAYERDEPENDS:zarhus-webkit = " \
    core \
    openembedded-layer \
    meta-webkit \
    "

LAYERSERIES_COMPAT:zarhus-webkit = "scarthgap master"
```
